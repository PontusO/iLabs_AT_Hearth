## platform/nrf54l15/boards/ilabs/ophelia_cpico/Kconfig.ophelia_cpico
```kconfig
config BOARD_OPHELIA_CPICO
    select SOC_NRF54L15_CPUAPP if BOARD_OPHELIA_CPICO_NRF54L15_CPUAPP
```

## platform/nrf54l15/boards/ilabs/ophelia_cpico/board.yml
```yaml
board:
  name: ophelia_cpico
  full_name: iLabs CPico with Wurth Ophelia-IV
  vendor: ilabs
  socs:
    - name: nrf54l15
```
